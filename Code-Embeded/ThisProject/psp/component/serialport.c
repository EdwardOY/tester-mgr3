/**
  ******************************************************************************
  * @file    serialport.c
  * @author  Edw·OY
  * @brief   Serial Port Driver
	* @version V1.2
	* @state	 finished 
  @verbatim     
  @endverbatim
  ******************************************************************************
  * @update
	    V1.2(√) 2022.6.29  DBCOM_IRQHandler(void)
			    DBCOM_ppg --> Uarts_ppg_p[DBCOMs]
	    V1.1(√) 2022.4.9
			   1.1.1 bsp_dbcom_init()
				   [+] _nvirq_cfg(DBCOM_ppg.uartdma_rx);	
           [+] _nvirq_cfg(DBCOM_ppg.uartdma_tx);	
  *   V1.0(√) 2022.3.26
  ******************************************************************************
  ******************************************************************************
  * @attention
  *   1 若激活DMA，那么使能DMA的RCC时钟要先于使能uart的RCC时钟
  *   2 DBCOM_IRQHandler(void)
        pBuff must initially point to DBCOM_ppg.rxbuf, 
           not Uarts_ppg_g[DBCOMs]->rxbuf(because pointer-address cannot be established before)

  ******************************************************************************	
	 ==============================================================================
                        ##### How to use this driver #####
  ==============================================================================
  */ 

/* Includes ------------------------------------------------------------------*/
#include  "./component/serialport.h"
#include DLY_HEAD
//#include MISC_HEAD
#include UART_HEAD
#include BSP_RES_HEAD

/**
 * @brief	(Verified) DBCOM dma overflag of Transmiting    
 * @param void
 * @return void
 * @Atten
     1若激活DMA，那么使能DMA的RCC时钟要先于使能uart的RCC时钟
 * @update
         
 */
//void bsp_dbcom_init()
//{


//}

/**
 * @brief  DBCOM 初始化
           verified and valid
 * @param  void
 * @notice
        -1-,必须设置正确的时钟源, 否则串口波特率就会设置异常.
 *          这里的USART的时钟源在sys_stm32_clock_init()函数中已经设置过了.
        -2-,based on usart.h/c generated by cbx
        HAL_UART_Receive_IT(&g_dbcom_handle, (uint8_t *)g_dbcom_rx_hdbuf, HdBuf_Size);
 * @retval void
 */
void bsp_dbcom_init(u32_t baudrate) 
{
//step1,optional,enable DBCOM-dma clock,

//step2,cfg init DBCOM prp

//step3,cfg nvic and enable them


//step4,add dma	and enable dma-nvic


//step5 clear and reset uart-RX	
//	app_dbcom_rst();	
}

/**
 * @brief  Reset dbcom`s rx(clear rxbuff and reset token)
 * @state  verifeid and valid
 * @note  
 * @param  void
 * @retval void
 *******bkcode*********
			  int tmp = strcmp((char*)g_dbcom_rxbuff,"Delate task1");
			  printf("\r\ntmp = %d, <%s>\r\n\r\n",tmp,(char*)g_dbcom_rxbuff);
			  app_dbcom_rst();
 */
void app_dbcom_rst(void)
{
   g_dbcom_rx_sta = 0;                 /* 清除接收状态标记 */
	 memset(g_dbcom_rxbuff,0,DBCOM_REC_LEN); //clear dbcom`s rxdatas_buff
}

/**
 * @brief      uartx 初始化函数
              该函数主要是初始化串口
 * @param       baudrate: 波特率, 根据自己需要设置波特率值
 * @param     sort,uart`s sortnumber defined at pjt_glb_head.h
 * @retval      无
 * @note  
       -1-,依赖cubemx生成的usart.c中的 MX_USARTx_UART_Init()
           MX_USARTx_UART_Init()完成 USARTx/UARTx的时钟、gpio、参数、nvic的配置
           MX_USARTx_UART_Init() should be before at this func
           
 */
void app_uart_init(emUartSort_t sort,uint32_t baudrate)
{
    /* USART 初始化设置 */
    Uarts[sort].huart->Instance        = Uarts[sort].uart;    //选择uart对应的串口  
    Uarts[sort].huart->Init.BaudRate   = baudrate;             //波特率 
    Uarts[sort].huart->Init.WordLength = UART_WORDLENGTH_8B;   //字长为8位数据格式 
    Uarts[sort].huart->Init.StopBits   = UART_STOPBITS_1;      // 一个停止位 
    Uarts[sort].huart->Init.Parity     = UART_PARITY_NONE;         /* 无奇偶校验位 */
    Uarts[sort].huart->Init.HwFlowCtl  = UART_HWCONTROL_NONE;   /* 无硬件流控 */
    Uarts[sort].huart->Init.Mode       = UART_MODE_TX_RX;            /* 收发模式 */
    HAL_UART_Init(Uarts[sort].huart);                        /* 使能对应的串口, 调用Msp */
//    __HAL_UART_DISABLE_IT(Uarts[sort].huart, UART_IT_TC);
}		
/**
 * @brief  Reset uart`s rx(clear rxbuff and reset token)
 * @state  verifeid and valid
 * @note  
 * @param  purt
 * @retval void
 *******bkcode*********
 */
void app_uart_rstrx(uart_para_t *purt)
{
	memset(purt->rxbuf,0,purt->rxbuf_len);
	purt->rxtkn        = False;
	purt->rxbuf_cnt    = 0;
	purt->rxbuf_precnt = 0;
}


/**
 * @brief  nonblock dbcom rx datas in poll with interrupt
 * @state  verified and valid
 * @note  
       -1-,Test with XCOM2.7
 * @param  void
 * @retval void
 *******bkcode*********
			  int tmp = strcmp((char*)g_dbcom_rxbuff,"Delate task1");
			  printf("\r\ntmp = %d, <%s>\r\n\r\n",tmp,(char*)g_dbcom_rxbuff);
			  app_dbcom_rst();
 */
void app_dbcom_rxpoll_it(void)
{
   static uint8_t len;
   static uv16_t times = 0;
	 if(g_dbcom_rx_sta & 0x8000) {        /* 接收到了数据? */
	 
				len = g_dbcom_rx_sta & 0x3fff;  /* 得到此次接收到的数据长度 */
				printf("\r\n您发送的消息为:\r\n");

				HAL_UART_Transmit(&g_dbcom_handle, (uint8_t*)g_dbcom_rxbuff, len, 1000);    /*发送接收到的数据*/

				while(__HAL_UART_GET_FLAG(&g_dbcom_handle, UART_FLAG_TC) != SET);           /*等待发送结束*/
				printf("\r\n\r\n"); 			/* 插入换行 */
			
		    app_dbcom_rst();
		 
		}else{   /* 未接收到了数据? */
				times++;

				if (times % 5000 == 0)
				{
						printf("\r\nEdwoy STM32F429IGTB 串口实验\r\n");
						printf("EDWOY@OUTLOOK.COM\r\n\r\n\r\n");
				}

				if (times % 200 == 0) printf("请输入数据,以回车键结束\r\n");

				if (times % 30  == 0) LED0_TOGGLE(); /* 闪烁LED,提示系统正在运行. */

				stkdly_ms(10);
		}	
}

/**
 * @brief  dbcom rx data to handle cmds
 * @state  verified and valid 
 * @note  
       -1-,Test with XCOM2.7
 * @param  void
 * @retval void
 *******bkcode*********
			  int tmp = strcmp((char*)g_dbcom_rxbuff,"Delate task1");
			  printf("\r\ntmp = %d, <%s>\r\n\r\n",tmp,(char*)g_dbcom_rxbuff);
			  app_dbcom_rst();
             HAL_UART_Transmit(&g_dbcom_handle, (uint8_t*)g_dbcom_rxbuff, len, 1000);
 */
void app_dbcom_cmd_hdr(u8_t* tmpvlu)
{
   static uint8_t len;
   static uv16_t times = 0;
	 if(g_dbcom_rx_sta & 0x8000)  /* 接收到了数据? */
		{       
				len = g_dbcom_rx_sta & 0x3fff;  /* 得到此次接收到的数据长度 */

        printf("\r\n您发送的消息为:\"%s\"\r\n",g_dbcom_rxbuff);
				
				while(__HAL_UART_GET_FLAG(&g_dbcom_handle, UART_FLAG_TC) != SET);           /*等待发送结束*/
			
				if(NULL == strcmp((char*)g_dbcom_rxbuff,
									 "Exit->>btns-scan<<")){
						*tmpvlu = 0;							 
										 
				 }else if(NULL == strcmp((char*)g_dbcom_rxbuff,
									 "edwmd->>btns-scan<<")){
						*tmpvlu = 1;							
										 
				 }else if(NULL == strcmp((char*)g_dbcom_rxbuff,
									 "atkmd->>btns-scan<<")){
						*tmpvlu = 2;							 
				 }
				 printf("tmpvlu = %d\r\n\r\n",*tmpvlu);					 

				 app_dbcom_rst(); 
		}	
}

void app_dbcom_cmd_hdr2(u8_t* tmpvlu)
{
   static uint8_t len;
   static uv16_t times = 0;
	 if(g_dbcom_rx_sta & 0x8000)  /* 接收到了数据? */
		{       
				len = g_dbcom_rx_sta & 0x3fff;  /* 得到此次接收到的数据长度 */

        printf("\r\n您发送的消息为:\"%s\"\r\n",g_dbcom_rxbuff);
				
				while(__HAL_UART_GET_FLAG(&g_dbcom_handle, UART_FLAG_TC) != SET);           /*等待发送结束*/
			
			   *tmpvlu = strtoul((char*)g_dbcom_rxbuff,NULL,0); //把字符串转化成 unsigned long 数据
				 printf("tmpvlu = %d\r\n\r\n",*tmpvlu);					 

				 app_dbcom_rst(); 
		}	
}

void bsp_dbcom_rstrx()
{
	_uart_rst_rx(&DBCOM_ppg);
//	DBCOM_RxTkn = False;
}

/**
 * @brief	debug com port 硬件中断入口服务函数
 * @param   void
 * @return  void
 * @atten,
 *    -1-, uart_rxbuf must be an array,not a pointer
 *    -2-, pBuff must initially point to DBCOM_ppg.rxbuf, 
           not Uarts_ppg_g[DBCOMs]->rxbuf(because pointer-address cannot be established before)
 ******bkup code**********
		HAL_UART_Receive(&DBCOM_HDR, pBuff++,1, 800);

 */
void DBCOM_IRQHandler(void) //default: USART1_IRQHandler
{	 
	static u8_t* pBuff = DBCOM_ppg.rxbuf; //uart_rxbuf 必须是数组，而不能为指针
  //RX通信时，Instance->DR有数据刷新，UART_FLAG_RXNE就会自动置位
	if(RESET != __HAL_UART_GET_FLAG(DBCOM_ppg.huart,UART_FLAG_RXNE)) 
	{ 
		 *(pBuff++) =  (u8_t)READ_REG(DBCOM_ppg.huart->Instance->DR); //rxvlu;	 

		 DBCOM_ppg.rxbuf_cnt++;		
		 __HAL_UART_CLEAR_FLAG(DBCOM_ppg.huart,UART_FLAG_RXNE);
	}

	//uart端口从繁忙转变到空闲(包含正常和故障)，UART_FLAG_IDLE就会自动置位
	if(RESET != __HAL_UART_GET_FLAG(DBCOM_ppg.huart,UART_FLAG_IDLE))
	{	   
//      printf("UartInt-IDLE responed\r\n"); 		
//		  DBCOM_RxTkn = True;        // 置位Rx接收完成标志
		  DBCOM_ppg.rxtkn = True; // 置位Rx接收完成标志
		  DBCOM_ppg.rxbuf_precnt = DBCOM_ppg.rxbuf_cnt; //记录上次接收数据的数量
		  DBCOM_ppg.rxbuf_cnt = 0;	//rxbuf计数器清零	  
		  pBuff = DBCOM_ppg.rxbuf;       //pBuff指针归位;
		  __HAL_UART_CLEAR_IDLEFLAG(DBCOM_ppg.huart);
	}	
   
   HAL_UART_IRQHandler(DBCOM_ppg.huart); //DBCOM接收中断可不用执行此步，中断型发送必须执行此步。且它调用回调函数
}//end:void DBCOM_IRQHandler(void)


/**
 * @brief	(Verified) DBCOM dma overflag of Transmiting    
 * @param void
 * @return void
 * @Atten
     1若激活DMA，那么使能DMA的RCC时钟要先于使能uart的RCC时钟
 * @update
         
 */
void bsp_serialport_init(u8_t sort)
{
//step1,enable DBCOM-dma clock
//	clock_enable_dma(Uarts_ppg[sort].huart.dmaclk);

//step2,cfg init DBCOM prp
	_uart_init(&Uarts_ppg[sort]);

//step3,cfg nvic and enable them
  _nvirq_cfg(Uarts_ppg[sort].uartnv);
  _nvirq_uart_en(&Uarts_ppg[sort], DBCOM_itsrc[0]); //	enable UART_IT_RXNE;接收中断
 	_nvirq_uart_en(&Uarts_ppg[sort], DBCOM_itsrc[1]); //	enable UART_IT_IDLE;通信空闲中断

//step4,add dma	and enable dma-nvic
//  _nvirq_cfg(DBCOM_ppg.uartdma_rx.dmanv);	
//  _nvirq_cfg(DBCOM_ppg.uartdma_tx.dmanv);	

//step5 clear and reset uart-RX	
	bsp_serialport_rstrx(sort); //_uart_rst_rx(&Uarts_ppg[sort]);
}

void bsp_serialport_rstrx(u8_t sort)
{
	_uart_rst_rx(&Uarts_ppg[sort]);

}


/**
 * @brief	debug com port DMA-Rx中断入口服务函数
          default,DMA2_Stream7_IRQHandler
 * @param   void
 * @return  void
 */
void DBCOM_DMA_TX_IRQHandler(void)
{
   LED_R_TogglePin;
	 HAL_DMA_IRQHandler(&DBCOM_ppg.uartdma_tx.hdma);
   
}
//  if(HAL_UART_Receive_DMA(&DBCOM_ppg.uartdma_rx.hdma, \
//		                     DBCOM_ppg.rxbuf, RXBUFFERSIZE)!= HAL_OK)
//  {
//    /* Transfer error in transmission process */
//    printf("In DBCOM_DMA_RX_IRQHandler, dma-rx over\r\n");   
//  }	

__weak void HAL_UART_TxCpltCallback(UART_HandleTypeDef *huart)
{
	if(huart == &DBCOM_HDR)
	{
     printf("In TxCpltCallback\r\n");
		
	}//end: if(huart == &DBCOM_HDR)
}

/*---EndLine: Full file----------------------------------------------------------------------------------------------------------*/





